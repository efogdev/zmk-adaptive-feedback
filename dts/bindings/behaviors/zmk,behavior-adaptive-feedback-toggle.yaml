## dts/bindings/behaviors/zmk,behavior-adaptive-feedback-toggle.yaml
```yaml
description: Toggle adaptive feedback on/off
compatible: "zmk,behavior-adaptive-feedback-toggle"
include: one_param.yaml
```

## dts/bindings/zmk,adaptive-feedback-event.yaml
```yaml
description: ZMK Adaptive Feedback per-event LED configuration

compatible: "zmk,adaptive-feedback-event"

properties:
  event-type:
    type: string
    required: true
    enum:
      - "layer"
      - "battery-warning"
      - "battery-critical"
      - "usb-connected"
      - "usb-disconnected"
      - "ble-profile-changed"
      - "idle"
      - "no-endpoint"
      - "studio-unlocked"
      - "studio-locked"
      - "custom"

  custom-event-name:
    type: string
    description: >
      Name of the custom event to configure (must match a ZAF_CUSTOM_EVENT_DEFINE name).
      Only used when event-type is "custom".

  layer-index:
    type: int
    default: 0

  battery-level:
    type: int
    default: 1

  colors:
    type: uint8-array
    required: true

  persistent:
    type: boolean

  animation:
    type: string
    default: "solid"
    enum:
      - "solid"
      - "blink"
      - "breathe"
      - "flash"

  blink-on-ms:
    type: int
    default: 500

  blink-off-ms:
    type: int
    default: 500

  flash-duration-ms:
    type: int
    default: 300

  flash-ease-in-ms:
    type: int
    default: 0
    description: >
      Duration of the fade-in easing phase at the start of the flash (ms).
      0 means the LED turns ON instantly (default).

  flash-ease-in-fn:
    type: string
    default: "linear"
    enum:
      - "linear"
      - "quad-in"
      - "quad-out"
      - "quad-in-out"
      - "cubic-in"
      - "cubic-out"
      - "cubic-in-out"
      - "quart-in"
      - "quart-out"
      - "quart-in-out"
      - "expo-in"
      - "expo-out"
      - "bounce-out"
      - "bounce-in"
    description: Easing curve applied during the flash fade-in phase.

  flash-ease-out-ms:
    type: int
    default: 0
    description: >
      Duration of the fade-out easing phase at the end of the flash (ms).
      0 means the LED turns OFF instantly (default).

  flash-ease-out-fn:
    type: string
    default: "linear"
    enum:
      - "linear"
      - "quad-in"
      - "quad-out"
      - "quad-in-out"
      - "cubic-in"
      - "cubic-out"
      - "cubic-in-out"
      - "quart-in"
      - "quart-out"
      - "quart-in-out"
      - "expo-in"
      - "expo-out"
      - "bounce-out"
      - "bounce-in"
    description: Easing curve applied during the flash fade-out phase.

  feedback-duration:
    type: int
    default: 0
```

## dts/bindings/zmk,adaptive-feedback.yaml
```yaml
description: ZMK Adaptive Feedback controller

compatible: "zmk,adaptive-feedback"

properties:
  led-strip:
    type: phandle
    required: true

  chain-length:
    type: int
    required: true

  error-slots:
    type: int

  error-slots-reverse:
    type: boolean
    description: >
      When set, error sections are allocated from the end of the chain
      (slot 0 is at the end, slot N is at the beginning).

  ext-power:
    type: phandle
    required: false

  feedback-enabled:
    type: boolean

  feedback-gpios:
    type: phandle-array
    required: false

  feedback-extra-gpios:
    type: phandle-array
    required: false

  feedback-delay:
    type: int
    default: 0
    description: >
      Delay in milliseconds between enabling ext-power / feedback-extra-gpios
      and actually triggering the feedback GPIO.

child-binding:
  description: Per-event LED configuration

  properties:
    label:
      type: string

    event-type:
      type: string
      required: true
      enum:
        - "layer"
        - "battery-warning"
        - "battery-critical"
        - "usb-connected"
        - "usb-disconnected"
        - "ble-profile-changed"
        - "idle"
        - "no-endpoint"
        - "studio-unlocked"
        - "studio-locked"
        - "custom"
        - "error"

    custom-event-name:
      type: string
      description: >
        Name of the custom event to configure (must match a ZAF_CUSTOM_EVENT_DEFINE name).
        Only used when event-type is "custom".

    layer-index:
      type: int
      default: 0

    battery-level:
      type: int
      default: 1

    error-slot-index:
      type: int
      default: 0
      description: >
        Error slot index (0-based). Only used when event-type is "error".
        Selects which error slot to configure.

    colors:
      type: uint8-array
      required: true

    persistent:
      type: boolean

    animation:
      type: string
      default: "solid"
      enum:
        - "solid"
        - "blink"
        - "breathe"
        - "flash"

    blink-on-ms:
      type: int
      default: 500

    blink-off-ms:
      type: int
      default: 500

    flash-duration-ms:
      type: int
      default: 300

    flash-ease-in-ms:
      type: int
      default: 0
      description: >
        Duration of the fade-in easing phase at the start of the flash (ms).
        0 means the LED turns ON instantly (default).

    flash-ease-in-fn:
      type: string
      default: "linear"
      enum:
        - "linear"
        - "quad-in"
        - "quad-out"
        - "quad-in-out"
        - "cubic-in"
        - "cubic-out"
        - "cubic-in-out"
        - "quart-in"
        - "quart-out"
        - "quart-in-out"
        - "expo-in"
        - "expo-out"
        - "bounce-out"
        - "bounce-in"
      description: Easing curve applied during the flash fade-in phase.

    flash-ease-out-ms:
      type: int
      default: 0
      description: >
        Duration of the fade-out easing phase at the end of the flash (ms).
        0 means the LED turns OFF instantly (default).

    flash-ease-out-fn:
      type: string
      default: "linear"
      enum:
        - "linear"
        - "quad-in"
        - "quad-out"
        - "quad-in-out"
        - "cubic-in"
        - "cubic-out"
        - "cubic-in-out"
        - "quart-in"
        - "quart-out"
        - "quart-in-out"
        - "expo-in"
        - "expo-out"
        - "bounce-out"
        - "bounce-in"
      description: Easing curve applied during the flash fade-out phase.

    feedback-pattern:
      type: uint8-array
      description: >
        Feedback pattern: alternating ON/OFF durations in milliseconds.

    breathe-duration-ms:
      type: int
      default: 3000
      description: >
        Duration of a single breathe cycle in milliseconds.
        Only used when animation is "breathe".
```

## dts/bindings/zmk,adaptive-rgb.yaml
```yaml
description: ZMK Adaptive RGB LED controller

compatible: "zmk,adaptive-rgb"

properties:
  led-strip:
    type: phandle
    required: true

  chain-length:
    type: int
    required: true

  ext-power:
    type: phandle
    required: false

  feedback-enabled:
    type: boolean

  feedback-gpios:
    type: phandle-array
    required: false

  feedback-extra-gpios:
    type: phandle-array
    required: false

  feedback-delay:
    type: int
    default: 0
    description: >
      Delay in milliseconds between enabling ext-power / feedback-extra-gpios
      and actually triggering the feedback GPIO.

  battery-levels:
    type: int
    default: 3
    description: >
      Number of discrete battery-warning / battery-critical severity levels
      (matching the battery-level values used in child event entries).

child-binding:
  description: Per-event LED configuration

  properties:
    event-type:
      type: string
      required: true
      enum:
        - "layer"
        - "battery-warning"
        - "battery-critical"
        - "usb-connected"
        - "usb-disconnected"
        - "ble-profile-changed"
        - "idle"
        - "no-endpoint"

    layer-index:
      type: int
      default: 0

    battery-level:
      type: int
      default: 1

    colors:
      type: uint8-array
      required: true

    persistent:
      type: boolean

    animation:
      type: string
      default: "solid"
      enum:
        - "solid"
        - "blink"
        - "breathe"
        - "flash"

    blink-on-ms:
      type: int
      default: 500

    blink-off-ms:
      type: int
      default: 500

    flash-duration-ms:
      type: int
      default: 300

    feedback-duration:
      type: int
      default: 0
```

## src/Kconfig
```kconfig
config ZMK_ADAPTIVE_FEEDBACK
    bool "Adaptive Feedback"
    select LED_STRIP
    default y

if ZMK_ADAPTIVE_FEEDBACK

config ZMK_ADAPTIVE_FEEDBACK_MAX_COLORS
    int "Maximum number of colors per event entry"
    default 4
    range 1 16

config ZMK_ADAPTIVE_FEEDBACK_BATT_LEVEL_COUNT
    int "Number of battery level entries"
    default 3
    range 1 10

config ZMK_ADAPTIVE_FEEDBACK_MAX_ERROR_SLOTS
    int "Maximum number of error message slots"
    default 8
    range 1 32

config ZMK_ADAPTIVE_FEEDBACK_BATT_WARN_THRESH_1
    int "Battery warning threshold 1 (%)"
    default 30
    range 0 100

config ZMK_ADAPTIVE_FEEDBACK_BATT_WARN_THRESH_2
    int "Battery warning threshold 2 (%)"
    default 25
    range 0 100

config ZMK_ADAPTIVE_FEEDBACK_BATT_WARN_THRESH_3
    int "Battery warning threshold 3 (%)"
    default 20
    range 0 100

config ZMK_ADAPTIVE_FEEDBACK_BATT_CRIT_THRESH_1
    int "Battery critical threshold 1 (%)"
    default 15
    range 0 100

config ZMK_ADAPTIVE_FEEDBACK_BATT_CRIT_THRESH_2
    int "Battery critical threshold 2 (%)"
    default 10
    range 0 100

config ZMK_ADAPTIVE_FEEDBACK_BATT_CRIT_THRESH_3
    int "Battery critical threshold 3 (%)"
    default 5
    range 0 100

config ZMK_ADAPTIVE_FEEDBACK_TICK_MS
    int "Animation tick interval (msec)"
    default 25
    range 10 500

config ZMK_ADAPTIVE_FEEDBACK_BRIGHTNESS
    int "Global brightness (0-100%)"
    default 100
    range 0 100

config ZMK_ADAPTIVE_FEEDBACK_BREATHE_DEFAULT_MS
    int "Breathe animation step count"
    default 1500
    range 100 10000

endif

rsource "shell/Kconfig"
rsource "behaviors/Kconfig"
```

## src/behaviors/Kconfig
```kconfig
config ZMK_BEHAVIOR_ADAPTIVE_FEEDBACK_TOGGLE
    bool "Adaptive Feedback Toggle behavior"
    depends on ZMK_ADAPTIVE_FEEDBACK
    default y
```

## src/shell/Kconfig
```kconfig
if SHELL

config ZMK_ADAPTIVE_FEEDBACK_SHELL
    bool "Adaptive Feedback shell commands"
    depends on ZMK_ADAPTIVE_FEEDBACK
    default n

endif
```
